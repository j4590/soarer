#include <TFT.h>  // Arduino LCD library
#include <SPI.h>
#define cs   10
#define dc   9
#define rst  8  

TFT TFTscreen = TFT(cs, dc, rst);
#if 0
const char *gryphon[]={
"                         +      ", // 0
"                        +X@     ", // 1
"                       OXoo     ", // 2
"                      oo@X @    ", // 3
"                     oO oXOO+   ", // 4
"                    oO o. O X   ", // 5
"                   oo X. @.+.   ", // 6
"         @@      @X.OXX @.O@.   ", // 7
"       @+X o+   @.o@ . +.O X+   ", // 8
"       o.  . o OX.@XXo+.+@oO    ", // 9
"       @oX.  X.o ..o X o X+     ", // 10
"o .+   . .   X. + X+o.+o.O      ", // 11
"O.  @   o.   XO+ @+  @+ +       ", // 12
"   o.  @o.   XXX@ oXOO.+        ", // 13
"   @ X@@XX..X X@@.o O.@  @      ", // 14
"    o .OoXXX  o+X+ oX@  @o      ", // 15
"       .o        X.  .O  ..OoO+ ", // 16
"     + .o              .+@X.O@+o", // 17
"      +O                 O     O", // 18
"     @o                  Xo@@ @+", // 19
"   +o.Xo+Oo.            X @OO+O@", // 20
"OXX X+     @++OooooX    O    @  ", // 21
". o+            ...o    .@      ", // 22
"@               o  XX     .o    ", // 23
"                 @ X @+oX. o    ", // 24
"              @  .X      @.@    ", // 25
"             X XX        +.@    ", // 26
"             +ooo+       + @    ", // 27
"                      +....@    ", // 28
"                      ++..O     "  // 29
};
#endif

const char *soarer[]={
"....................................................................................................",
"...........................   ......................................................................",
".........           .....        ..........   ........         ......           ...          .......",
"........    ...    ....    ...    ........    ........          .....          ....           ......",
".......   ........ ...   ......   ........     ......   ......   ....   ...........   .....   ......",
".......  ............   ........   ......      ......   ......   ....   ..........   ......   ......",
".......   ...........   ........   .....   .   ......   .....    ...   ...........   ......   ......",
".......        .....   .........   ....   ..   ......   ....    ....    ...  .....   ...     .......",
"........         ...   .........   ....  ....  .....   .       .....         ....   ..     .........",
"..........        ..   .........   ...   ...    ....   ..   ........        .....   ..    ..........",
"...............    .   .........   ..           ....   ...  .......   ...........   ...   ..........",
"................   .   ........    ..  ....     ...   ....   ......   ...........   ....   .........",
"................  ..   ........   ..  .......   ...   .....   .....   ..........   ......   ........",
"....  .........   ...   ......   ..   .......   ...   .....   ....   ...........   .......   .......",
"....      ...    ....   .....   ..   .........   ..   ......   ...            ..   .......    ......",
"....            ......         ...  ..........   .   ........   ..           ..   .........    .....",
"........................    .................................................................    ...",
"...................................................................................................."
};


void setup() {
  TFTscreen.begin();
  TFTscreen.background(0, 0, 0);
  TFTscreen.stroke(255,255,255);
  TFTscreen.setTextSize(2);
  //TFTscreen.text("SOARER 3000GT",2,18);

#if 0
  TFTscreen.text(  "Sat Jan 31",2,18);
  TFTscreen.setTextSize(3);
  TFTscreen.stroke(0,255,0);
  TFTscreen.text("00:49:45",7,36);
#endif

/*
"  c  000000",
". c  303030",
"X c  4E4E4E",
"o c  717171",
"O c  8E8E8E",
"+ c  ADADAD",
"@ c  F2D2D2",
*/
  for(int y=0;y<18;y++){
    for(int x=0;x<100;x++){
      switch(soarer[y][x]){
        case '.': TFTscreen.stroke(0,0,0); break;
        case ' ': TFTscreen.stroke(0xff,0xff,0xff); break;
      }
      TFTscreen.point(x+30,y+0);
    }
  }

  delay(1000);
}

void loop() {
  static int count=0;
  char buf[20];

  TFTscreen.stroke(0xff,0xff,0);
  sprintf(buf,"%8d",count);
  TFTscreen.text(buf,30,30);
  delay(1000);
  TFTscreen.stroke(0,0,0);
  TFTscreen.text(buf,30,30);
  count++;
}

